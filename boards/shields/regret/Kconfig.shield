## boards/shields/regret/Kconfig.shield
```kconfig
# Copyright (c) 2020 ZMK Contributors
# SPDX-License-Identifier: MIT

config SHIELD_REGRET
    def_bool $(shields_list_contains,regret)
    select SPI
```

## config/boards/shields/regret/Kconfig.defconfig
```kconfig
# Copyright (c) 2022 ZMK Contributors
# SPDX-License-Identifier: MIT

if SHIELD_REGRET

config ZMK_KEYBOARD_NAME
    default "Re-gret"

endif
```

## config/boards/shields/scylla_xiao/Kconfig.defconfig
```kconfig
# Copyright (c) 2022 ZMK Contributors
# SPDX-License-Identifier: MIT


if SHIELD_SCYLLA_XIAO_RIGHT

config ZMK_KEYBOARD_NAME
	default "ScyllaXiaoR"

config ZMK_SPLIT_ROLE_CENTRAL
	default y

endif

if SHIELD_SCYLLA_XIAO_LEFT

config ZMK_KEYBOARD_NAME
	default "ScyllaXiaoL"

config ZMK_SPLIT_ROLE_CENTRAL
	default n
endif

if SHIELD_SCYLLA_XIAO_LEFT || SHIELD_SCYLLA_XIAO_RIGHT

config ZMK_SPLIT
	default y

endif
```

## config/boards/shields/scylla_xiao/Kconfig.shield
```kconfig
# Copyright (c) 2020 ZMK Contributors
# SPDX-License-Identifier: MIT

config SHIELD_SCYLLA_XIAO_LEFT
	def_bool $(shields_list_contains,scylla_xiao_left)

config SHIELD_SCYLLA_XIAO_RIGHT
	def_bool $(shields_list_contains,scylla_xiao_right)
```
